/*************************************************************
*       Siemens Re-chargeable Emergency Notifier Wristband (SIREN)
*       EE459 Spring 2011 Team 5B (wristband): Hieu Nguyen, Bauyrkhan Krykpayev, Stephanie Shinohara
*
*       Port A, bit 0 - output to green LED anode (1 = LED on, 0 = LED off)
*       Port A, bit 1 - input from water-immersion sensor (0 = H2O, 1 = no H2O)
*       Port A, bit 2 - output to buzzer (1 = off, 0 = on)
*       Port A, bit 3 - input from button (0 = pressed, 1 = not pressed)
*       Port A, bit 4 - output to red LED anode (1 = LED on, 0 = LED off)
*
*       Graphic LCD 84x48 pixels:
*       Port B, bit 0 - LCD chip enable  (active high)
*       Port B, bit 1 - LCD reset (active low)
*       Port B, bit 2 - LCD D/~C (1 = Data being transmitted, 0 = Control)
*       Port B, bit 3 - LCD serial data line
*       Port B, bit 4 - LCD clock for serial interface
*       Port B, bit 5 - LCD backlight power supply
*
*       Transceiver
*       Port D, bit 0 - RxAnt
*       Port D, bit 1 - TxAnt
*       Port D, bit 2 - IRQ
*       Port D, bit 3 - CSN
*       Port D, bit 4 - SCK
*       Port D, bit 6 - SDI
*       Port D, bit 7 - SDO
*
*************************************************************/

#include <hidef.h> /* for EnableInterrupts macro */
#include "derivative.h" /* include peripheral declarations */

typedef unsigned char uchar;
typedef unsigned int uint;


#define LED_GREEN      PTA_PTA0
#define H2O_SENSE      PTA_PTA1
#define BUZZER         PTA_PTA2
#define BUTTON         !PTA_PTA3
#define LED_RED        PTA_PTA4

#define LCD_SCE        PTB_PTB0
#define LCD_RST        PTB_PTB1
#define LCD_DC         PTB_PTB2
#define LCD_DN         PTB_PTB3
#define LCD_SCLK       PTB_PTB4
#define LCD_BACKLIGHT  PTB_PTB5

#define XCVR_RxANT    PTD_PTD0   
#define XCVR_TxANT    PTD_PTD1    
#define XCVR_IRQ      PTD_PTD2   
#define XCVR_CSN      PTD_PTD3 
#define XCVR_SCK      PTD_PTD4   
#define XCVR_SDI      PTD_PTD6 
#define XCVR_SDO      PTD_PTD7

#define LCD_CTR  0
#define LCD_DAT  1

#define LCD_WIDTH  84
#define LCD_HEIGHT 48

#define BATTERY_HIGH     3
#define BATTERY_MED      2
#define BATTERY_LOW      1
#define BATTERY_EMPTY    0



void interrupt waterISR(void);  
void system_init(void);  
void wait500ms(void); 
void wait100ms(void);  
void wait5ms(void);
void low_battery_detect(void);
void wristband_sync(void);
void locate_wristband(void);

void lcd_init(void); 
void lcd_display(unsigned char array_b[], char f); 
void lcd_bmp(unsigned char array_b[], unsigned char array_w[], unsigned char array_f[]);
void lcd_full_bmp(unsigned char array[]);
void lcd_sync(unsigned char array_b[]);
void lcd_clear(void); 
void lcd_backlight(char enabled);
void lcd_write(char dc, char data); 
 
void send_read_address(uchar addr);   
uchar send_command(void);  
void to_rx_mode(void);  
void to_tx_mode(unsigned char buf[], int size);
void rx_reset(void);  
void init_RFM22(void);
char readByte(char address);
void writeByte(char address, char data);
void write1();
void write0();


//Global Variables
uchar water_buf[17] = {0x30, 0xab, 0xcd, 0xef, 0x34, 0x35, 0x36, 0x37, 0x38, 0x39, 0x3A, 0x3B, 0x3C, 0x3D, 0x3E, 0x3F, 0x78};
uchar locate_buf[17] = {0x29, 0x31, 0x32, 0x33, 0x34, 0x35, 0x36, 0x37, 0x38, 0x39, 0x3A, 0x3B, 0x3C, 0x3D, 0x3E, 0x3F, 0x78};
uchar locate_buf2[17] = {0x28, 0x31, 0x32, 0x33, 0x34, 0x35, 0x36, 0x37, 0x38, 0x39, 0x3A, 0x3B, 0x3C, 0x3D, 0x3E, 0x3F, 0x78};
uchar sync_send_buf[17] = {0x27, 0xab, 0xcd, 0xef, 0x34, 0x35, 0x36, 0x37, 0x38, 0x39, 0x3A, 0x3B, 0x3C, 0x3D, 0x3E, 0x3F, 0x78};
uchar sync_rec_buf[17] = {0x26, 0x12, 0x34, 0x56, 0x34, 0x35, 0x36, 0x37, 0x38, 0x39, 0x3A, 0x3B, 0x3C, 0x3D, 0x3E, 0x3F, 0x78};
uchar sync_confirm_buf[17] = {0x25, 0xab, 0xcd, 0xef, 0x34, 0x35, 0x36, 0x37, 0x38, 0x39, 0x3A, 0x3B, 0x3C, 0x3D, 0x3E, 0x3F, 0x78};
uchar RF_RXBUF[35];
uchar * batt_level;
uchar base_id[3] = {0x00, 0x00, 0x00};
int battery_level;
uchar one = 1;


#pragma CODE_SEG MY_ISR_ROM

#pragma TRAP_PROC
void dummyISR(void)
{
}

#pragma CODE_SEG DEFAULT


const unsigned char siem [] = {
0x00, 0x00, 0x00, 0x00, 0x00, 0x00, 0x00, 0x00, 0x00, 0x00, 0x00, 0x00, 0x00, 0x00, 0x00, 0x00,
0x00, 0x00, 0x00, 0x00, 0x00, 0x00, 0x00, 0x00, 0x00, 0x00, 0x00, 0x00, 0x00, 0x00, 0x00, 0x00,
0x00, 0x00, 0x00, 0x00, 0x00, 0x00, 0x00, 0x00, 0x00, 0x00, 0x00, 0x00, 0x00, 0x00, 0x00, 0x00,
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0x00, 0x00, 0x00, 0x00, 0x00, 0x00, 0x00, 0x00, 
};

const unsigned char siren [] ={  
0x00, 0x00, 0x00, 0x00, 0x00, 0x00, 0x00, 0x00, 0x00, 0x00, 
0x00, 0x00, 0x00, 0x00, 0x00, 0x46, 0x49, 0x49, 0x49, 0x31, 
0x00, 0x00, 0x41, 0x7f, 0x41, 0x00, 0x00, 0x7f, 0x09, 0x19,
0x29, 0x46, 0x00, 0x7f, 0x49, 0x49, 0x49, 0x41, 0x00, 0x7f,
0x04, 0x08, 0x10, 0x7f, 0x00, 0x00, 0x00, 0x00, 0x00, 0x00,
0x00, 0x00, 0x00, 0x00, 0x00, 0x00, 0x00, 0x00, 0x00, 0x00,
0x00, 0x00, 0xA0, 0x00, 0xF0, 0x00, 0xFA, 0x00, 0xFF, 0x00, 
};

const unsigned char sync [] = {
0x00, 0x00, 0x00, 0x00, 0xC0, 0xE0, 0x20, 0x20, 0x20, 0xE0, 0xC0, 0x00, 0x00, 0x00, 0x00, 0x00,
0x00, 0x00, 0x00, 0x00, 0x00, 0x00, 0x00, 0x00, 0x00, 0x00, 0x00, 0x00, 0x00, 0x00, 0x00, 0x00,
0x00, 0x00, 0x00, 0x00, 0x60, 0x60, 0x00, 0x00, 0x00, 0x00, 0x00, 0x00, 0x00, 0x00, 0x00, 0x00,
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0x00, 0x00, 0x00, 0x00, 0x00, 0x00, 0x00, 0x00, 0x00, 0x00, 0x00, 0x00, 
};

const unsigned char batt_empty [] = {
0xFF, 0x81, 0x81, 0x81, 0x81, 0x81, 0x81, 0x81, 0x81, 0x81, 0x81, 0xFF, 0x3C, 0x3C, 
};

const unsigned char batt_low [] = {
0xFF, 0x81, 0xBD, 0xBD, 0x81, 0x81, 0x81, 0x81, 0x81, 0x81, 0x81, 0xFF, 0x3C, 0x3C, 
};

const unsigned char batt_med [] = {
0xFF, 0x81, 0xBD, 0xBD, 0x81, 0xBD, 0xBD, 0x81, 0x81, 0x81, 0x81, 0xFF, 0x3C, 0x3C, 
};

const unsigned char batt_high [] = {
0xFF, 0x81, 0xBD, 0xBD, 0x81, 0xBD, 0xBD, 0x81, 0xBD, 0xBD, 0x81, 0xFF, 0x3C, 0x3C, 
};

const unsigned char fish0 [] = {
0x00, 0x00, 0x00, 0x00, 0x00, 0x00, 0x00, 0x00, 0x00, 0x00, 0x00, 0x00, 0x00, 0x00, 0x00, 0x00,
0x00, 0x00, 0x00, 0x00, 0x70, 0x50, 0x70, 0x00, 0x00, 0x00, 0x07, 0x05, 0x07, 0x00, 0x00, 0x00,
0x00, 0x00, 0x00, 0x00, 0x00, 0x00, 0x00, 0x00, 0x00, 0x00, 0x00, 0x00, 0x00, 0x00, 0x00, 0x00,
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0x00, 0x00, 0x00, 0x00, 
};

const unsigned char fish1 [] = {
0x00, 0xE0, 0x40, 0x40, 0x80, 0x00, 0x06, 0x1A, 0x22, 0x24, 0x44, 0x84, 0x88, 0xC8, 0xF8, 0xF8,
0xF8, 0x70, 0x10, 0x10, 0x10, 0x10, 0x20, 0x20, 0xE0, 0xC0, 0xC0, 0xC0, 0x00, 0x00, 0x00, 0x00,
0x00, 0x00, 0x00, 0x00, 0x00, 0x00, 0x00, 0x00, 0x00, 0x00, 0x00, 0x00, 0x00, 0x00, 0xE0, 0xA0,
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0x00, 0x00, 0x00, 0x00, 
};

const unsigned char fish2 [] = {
0x00, 0x00, 0x00, 0x00, 0x00, 0x00, 0x00, 0x00, 0x00, 0x00, 0x00, 0x00, 0x00, 0x00, 0x00, 0x00,
0x00, 0x00, 0x00, 0x00, 0x00, 0x00, 0x00, 0x00, 0x00, 0x00, 0x00, 0x00, 0x00, 0x00, 0x00, 0x00,
0x00, 0x00, 0x00, 0x00, 0x00, 0x00, 0x00, 0x00, 0x00, 0x00, 0x00, 0x00, 0x00, 0x00, 0x00, 0x00,
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0x00, 0x00, 0x00, 0x00, 
};

const unsigned char fish3 [] = {
0x00, 0x00, 0x00, 0x00, 0x00, 0x00, 0x00, 0x00, 0x00, 0x00, 0x00, 0x00, 0x00, 0x00, 0x00, 0x00,
0x00, 0x00, 0x00, 0x00, 0x00, 0x00, 0x00, 0x00, 0x00, 0x00, 0x00, 0x00, 0x00, 0x00, 0x00, 0x00,
0x00, 0x00, 0x00, 0xF8, 0x10, 0x90, 0xE0, 0x80, 0x81, 0x06, 0x08, 0x09, 0x11, 0x61, 0xE2, 0xF2,
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0x00, 0x00, 0x00, 0x00, 
};

const unsigned char fish4 [] = {
0x00, 0x00, 0x00, 0x00, 0x00, 0x00, 0x00, 0x00, 0x00, 0x00, 0x00, 0x00, 0x00, 0x00, 0x00, 0x00,
0x00, 0x00, 0x00, 0x00, 0x00, 0x00, 0x00, 0x00, 0x00, 0x00, 0x00, 0x00, 0x00, 0x00, 0x00, 0x00,
0x00, 0x00, 0x00, 0x00, 0x00, 0x00, 0x00, 0x00, 0x00, 0x00, 0x00, 0x00, 0x00, 0x00, 0x00, 0x00,
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0x05, 0x03, 0x00, 0x00, 
};

const unsigned char sync_succ [] = {
0x00, 0x00, 0x00, 0x00, 0x00, 0x00, 0x00, 0x00, 0x00, 0x00, 0x00, 0x00, 0x00, 0x00, 0x00, 0x00,
0x00, 0x00, 0x00, 0x00, 0x00, 0x00, 0x00, 0x00, 0x00, 0x00, 0x00, 0x00, 0x00, 0x00, 0x00, 0x00,
0x00, 0x00, 0x00, 0x00, 0x00, 0x00, 0x00, 0x00, 0x00, 0x00, 0x00, 0x00, 0x00, 0x00, 0x00, 0x00,
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0x00, 0x00, 0x00, 0x00, 
};

const unsigned char sync_fail [] = {
0x00, 0x00, 0x00, 0x00, 0x80, 0xC0, 0x40, 0x40, 0x40, 0xC0, 0x80, 0x00, 0x00, 0x00, 0x00, 0x00,
0x00, 0x00, 0x00, 0x00, 0x00, 0x00, 0x00, 0x00, 0x00, 0x00, 0x00, 0x00, 0x00, 0x00, 0x00, 0x00,
0x00, 0x00, 0x00, 0x00, 0x00, 0x00, 0x00, 0xC0, 0xC0, 0x40, 0x40, 0x40, 0x40, 0x40, 0x00, 0x00,
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0x00, 0x00, 0x00, 0x00, 
};



void write0() 
{
	XCVR_SCK = 0;
	XCVR_SDI = 0;
	XCVR_SCK = 1;
}

void write1() 
{
	XCVR_SCK = 0;
	XCVR_SDI = 1;
	XCVR_SCK = 1;
}

void writeByte(char address, char data) 
{
	char cnt;
	address |= 0x80;
	XCVR_SCK = 0;
	XCVR_CSN = 0;
	for(cnt=0 ; cnt<8 ; cnt++) {
	if(address & 0x80)
	  write1();
	else
	  write0();
	address <<= 1;
	}
	for(cnt=0 ; cnt<8 ; cnt++) {
	if(data & 0x80)
	  write1();
	else
	  write0();
	data <<= 1;
	}
	XCVR_SCK = 0;
	XCVR_CSN = 1;
}

char readByte(char address) 
{
	char cnt, read_data;
	address &= 0x7F;  
	XCVR_SCK = 0;
	XCVR_CSN = 0;
	for(cnt=0 ; cnt<8 ; cnt++) {
	if(address & 0x80)
	  write1();
	else
	  write0();
	address <<= 1;
	}
	read_data = 0x00;
	for(cnt=0 ; cnt<8 ; cnt++) {
	read_data <<= 1;
	XCVR_SCK = 0;
	if(XCVR_SDO == 1)
	  read_data |= 0x01;
	XCVR_SCK = 1;
	}
	XCVR_SCK = 0;
	XCVR_CSN = 1;
	return read_data;
}

// Initialize the RFM22 for transmitting
void init_RFM22(void) 
{
	writeByte(0x06, 0x00);	  	// Disable all interrupts, except LBD interrupt
	writeByte(0x07, 0x41);		// Set READY mode, and enable LBD
	
	writeByte(0x09, 0x7F);		// Cap = 12.5pF
	writeByte(0x0A, 0x2B);		// Clk output is 4MHz, on GPIO2
	
	writeByte(0x0B, 0xF4);		// GPIO0 is for RX data output
	writeByte(0x0C, 0xEF);		// GPIO1 is TX/RX data CLK output
	writeByte(0x0D, 0x00);		// GPIO2 for MCLK output
	writeByte(0x0E, 0x00);		// GPIO port use default value
	
	writeByte(0x0F, 0x70);		// NO ADC used
	writeByte(0x10, 0x00);		// no ADC used
	writeByte(0x12, 0x00);		// No temp sensor used
	writeByte(0x13, 0x00);		// no temp sensor used
	
	writeByte(0x70, 0x20);		// No manchester code, no data whiting, data rate < 30Kbps
	
	writeByte(0x1C, 0x1D);		// IF filter bandwidth
	writeByte(0x1D, 0x40);		// AFC Loop
	//writeByte(0x1E, 0x0A);	// AFC timing
	
	writeByte(0x20, 0xA1);		// clock recovery
	writeByte(0x21, 0x20);		// clock recovery
	writeByte(0x22, 0x4E);		// clock recovery
	writeByte(0x23, 0xA5);		// clock recovery
	writeByte(0x24, 0x00);		// clock recovery timing
	writeByte(0x25, 0x0A);		// clock recovery timing
	
	//writeByte(0x2A, 0x18);
	writeByte(0x2C, 0x00);
	writeByte(0x2D, 0x00);
	writeByte(0x2E, 0x00);
	
	writeByte(0x6E, 0x27);		// TX data rate 1
	writeByte(0x6F, 0x52);		// TX data rate 0
	
	writeByte(0x30, 0x8C);		// Data access control
	
	writeByte(0x32, 0xFF);		// Header control
	
	writeByte(0x33, 0x42);		// Header 3, 2, 1, 0 used for head length, fixed packet length, synchronize word length 3, 2,
	
	writeByte(0x34, 64);		// 64 nibble = 32 byte preamble
	writeByte(0x35, 0x20);		// 0x35 need to detect 20bit preamble
	writeByte(0x36, 0x2D);		// synchronize word
	writeByte(0x37, 0xD4);
	writeByte(0x38, 0x00);
	writeByte(0x39, 0x00);
	writeByte(0x3A, 's');		// set tx header 3
	writeByte(0x3B, 'o');		// set tx header 2
	writeByte(0x3C, 'n');		// set tx header 1
	writeByte(0x3D, 'g');		// set tx header 0
	writeByte(0x3E, 17);		// set packet length to 17 bytes
	
	writeByte(0x3F, 's');		// set rx header
	writeByte(0x40, 'o');
	writeByte(0x41, 'n');
	writeByte(0x42, 'g');
	writeByte(0x43, 0xFF);		// check all bits
	writeByte(0x44, 0xFF);		// Check all bits
	writeByte(0x45, 0xFF);		// check all bits
	writeByte(0x46, 0xFF);		// Check all bits
	
	writeByte(0x56, 0x01);
	
	writeByte(0x6D, 0x07);		// Tx power to max
	
	writeByte(0x79, 0x00);		// no frequency hopping
	writeByte(0x7A, 0x00);		// no frequency hopping
	
	writeByte(0x71, 0x22);		// GFSK, fd[8]=0, no invert for TX/RX data, FIFO mode, txclk-->gpio
	
	writeByte(0x72, 0x48);		// Frequency deviation setting to 45K=72*625
	
	writeByte(0x73, 0x00);		// No frequency offset
	writeByte(0x74, 0x00);		// No frequency offset
	
	writeByte(0x75, 0x53);		// frequency set to 434MHz
	writeByte(0x76, 0x64);		// frequency set to 434MHz
	writeByte(0x77, 0x00);		// frequency set to 434Mhz
	
	writeByte(0x5A, 0x7F);
	writeByte(0x59, 0x40);
	writeByte(0x58, 0x80);
	
	writeByte(0x6A, 0x0B);
	writeByte(0x68, 0x04);
	writeByte(0x1F, 0x03);
}

void to_tx_mode(unsigned char buf[], int size) 
{
	uchar i;
	writeByte(0x07, 0x41);		// Set READY mode, and enable LBD
	XCVR_RxANT = 0;
	XCVR_TxANT = 1;
	
	writeByte(0x08, 0x03);	// FIFO reset
	writeByte(0x08, 0x00);	// Clear FIFO
	writeByte(0x34, 64);	// preamble = 64nibble

	writeByte(0x3E, size);	// packet length = 17bytes
	for (i=0; i<size; i++)
	{
		writeByte(0x7F, buf[i]);	// send payload to the FIFO
	}

	writeByte(0x05, 0x04);	// enable packet sent interrupt
	i = readByte(0x03);		// Read Interrupt status1 register
	i = readByte(0x04);
	
	writeByte(0x07, 0x49);	// Start TX
	
	while(XCVR_IRQ);
	writeByte(0x07, 0x41);		// Set READY mode, and enable LBD
	
	XCVR_RxANT = 0;
	XCVR_TxANT = 0;
	LED_RED = 1; 	//red LED blinks on whenever something is transmitted
}

void rx_reset(void) 
{ 
	int i;
  	writeByte(0x07, 0x41);	// Set READY mode, and enable LBD
	i = readByte(0x03);		//read Interrupt Status1 reg
	i = readByte(0x04);
	writeByte(0x7E, 0x17);
	writeByte(0x08, 0x03);	//fifo reset
	writeByte(0x08, 0x00);
	writeByte(0x07, 0x45);
	writeByte(0x05, 0x02);
}

void to_rx_mode(void) 
{
	writeByte(0x07, 0x41);		// Set READY mode, and enable LBD
	XCVR_RxANT = 1;
	XCVR_TxANT = 0;
	rx_reset();
}

uchar send_command(void) 
{ 
	uchar Result, i; 
	XCVR_SCK = 0; 
	Result = 0; 
	for(i=0 ; i<8 ; i++) {                     
	Result = Result<<1; 
	XCVR_SCK = 1; 
	//NOP(); 
	if(XCVR_SDO) 
	  Result |= 1; 
	  
	XCVR_SCK = 0; 
	//NOP(); 
	}
	return(Result); 
}

void send_read_address(uchar addr) 
{ 
	uchar cnt = 8;
	addr &= 0x7f; // spi read funciton 

	XCVR_CSN = 1;
	XCVR_SCK = 0; 
	XCVR_CSN = 0;
	while(cnt--)  // cycle to 8 times 
	{ 
	 if(addr & 0x80)// send one bit command 
		write1(); 
	 else 
		write0();    
	 addr = addr << 1; 
	} 
}

void low_battery_detect(void) 
{
    //0x1A --- Low Battery Detector Threshold 8'bzzzxxxxx
    //0x1B --- Read Battery Voltage Level 8'b000xxxxx
    //set voltage thresholds to operate with voltage capabilities of uC and LCD
    //to deal with rx interrupts also on the IRQ pin, read 0x1B voltage ADC to determine if battery level should change
    uchar volt_lvl1, volt_lvl2, volt_lvl3, volt_lvl4, volt_lvl5, voltage_level, i, j, temp;
    uchar volt_array[5];
	
    volt_lvl1 = readByte(0x1B);
    volt_lvl2 = readByte(0x1B);
    volt_lvl3 = readByte(0x1B);
    volt_lvl4 = readByte(0x1B);
    volt_lvl5 = readByte(0x1B);
	
	volt_array[0] = volt_lvl1;
	volt_array[1] = volt_lvl2;
	volt_array[2] = volt_lvl3;
	volt_array[3] = volt_lvl4;
	volt_array[4] = volt_lvl5;
 
  for (j=0 ; j< 5; j++) {
    for (i=0 ; i<4 ; i++) {
      if(volt_array[i] > volt_array[i+1]) {
        temp = volt_array[i+1];
        volt_array[i+1] = volt_array[i];
        volt_array[i] = temp;
      }
    }
  }
    voltage_level = volt_array[2];  //the median of 5 readings
 
  if (voltage_level > 0x1C) {       //voltage is > 3.05V (ADC=28)
    batt_level = batt_high; 
  }
  else if (voltage_level > 0x17) {  //voltage is > 2.8V (ADC=23)
    batt_level = batt_med;
  }
  else if (voltage_level > 0x13) {  //voltage is > 2.6V (ADC=19)
    batt_level = batt_low;
  }
  else if (voltage_level <= 0x13) { //voltage is <= 2.6V (ADC=19)
    batt_level = batt_empty;
  }
  else {
    BUZZER = 0;
  }
  to_rx_mode();
}

void wristband_sync(void) 
{
	uchar i;
	int timer = 0;
	//if SYNC button pressed, transmit SYNC signal to base station (wristband in TX mode)
	to_tx_mode(sync_send_buf, 17);
	
	//wait for response --- handshaking
	to_rx_mode();
	lcd_clear();
	while(one)
	{
	    LED_GREEN = 1;  //green LED goes on when in sync mode, turns off when sync complete/failed
	    lcd_sync(batt_level); //show animated connectivity bars on LCD 
	    
	    if(XCVR_IRQ == 0) 
	    {  
    	    send_read_address(0x7F);
          for (i=0 ; i<17 ; i++)
             	RF_RXBUF[i] = send_command();
          if(RF_RXBUF[0] == 0x26)         //received response from base station
          {
              base_id[0] = RF_RXBUF[1]; //saving base station's id into a global variable
              base_id[1] = RF_RXBUF[2];
              base_id[2] = RF_RXBUF[3];
              rx_reset();
              to_tx_mode(sync_confirm_buf, 17); //send confirmation signal to base station that we got their id
              LED_GREEN = 0;
    		  //lcd_full_bmp(happy);  
    		  lcd_bmp(batt_level, siren, sync_succ); //sync successful screen on LCD
              wait100ms();
              to_rx_mode();
              break;
          }
	    }
      
      timer++;
      if (timer > 7)     //if response is not received in X sexonds
      {
          LED_GREEN = 0;
          //lcd_full_bmp(sad);  
          lcd_bmp(batt_level, siren, sync_fail); //sync fail screen on LCD
		  wait100ms();
          to_rx_mode();
          break;
      }
	}
	
}

void locate_wristband (void) 
{
	uchar i;
	wait5ms();
	LED_RED = 1;		
  	send_read_address(0x7F);
		for (i=0 ; i<17 ; i++)
			RF_RXBUF[i] = send_command();
		if(RF_RXBUF[0] == 0x29)   //1st byte of 1st word matches
		{			
			LED_GREEN = 1;
			if(RF_RXBUF[1] == base_id[0] && RF_RXBUF[2] == base_id[1] && RF_RXBUF[3] == base_id[2])  //next 3 bytes match the base id
			{
				BUZZER = 0;
				rx_reset();
				while(one) 
				{
					if(XCVR_IRQ == 0) 
					{
						send_read_address(0x7F);
						for (i=0 ; i<17 ; i++)
							RF_RXBUF[i] = send_command();
						if(RF_RXBUF[0]==0x28)  ////1st byte of 2nd word matches
						{	
							if(RF_RXBUF[1] == base_id[0] && RF_RXBUF[2] == base_id[1] && RF_RXBUF[3] == base_id[2]) //next 3 bytes match the base id
							{
								BUZZER = 1;
								to_rx_mode();
								return;
							}
						}
					}
					if(BUTTON == 1) 
					{
						BUZZER = 1;
						to_rx_mode();
						return;
					}
				}
			}	
		}
		else  
			to_rx_mode();
	
}

void lcd_write(char dc, char data)
{
	int i;
	if (dc)
		LCD_DC = 1;
	else
		LCD_DC = 0;
	LCD_SCE = 0;
	for (i=0; i<8; i++)
	{
		if(data & 0x80)
			LCD_DN = 1;
		else
			LCD_DN = 0;
		LCD_SCLK = 0;
		LCD_SCLK = 1;
		data <<=1;
	}
	LCD_SCE = 1;
	LCD_DN = 0;
}

void lcd_clear(void)
{
	int i;
	for (i=0; i<LCD_WIDTH*LCD_HEIGHT/8; i++)
		lcd_write(LCD_DAT, 0x00);
}

void lcd_sync(unsigned char array_b[])
{
  int i;
  for (i=0; i<14; i++)
     lcd_write(LCD_DAT, array_b[i]);
  for (i = 0; i < 70; i++)
		lcd_write(LCD_DAT, siren[i]);
  for (i=0; i <252; i++)
    lcd_write(LCD_DAT, sync[i]);
  for (i=0; i<6; i++)
    lcd_write(LCD_DAT, 0x00);
  for (i=0; i<8; i++)
    lcd_write(LCD_DAT, 0xFF);
  for (i=0; i<8; i++)
    lcd_write(LCD_DAT, 0x00);
  wait100ms();
  for (i=0; i<8; i++)
    lcd_write(LCD_DAT, 0xFF);
  for (i=0; i<8; i++)
    lcd_write(LCD_DAT, 0x00);
  wait100ms();
  for (i=0; i<8; i++)
    lcd_write(LCD_DAT, 0xFF);
  for (i=0; i<8; i++)
    lcd_write(LCD_DAT, 0x00);
  wait100ms();
  for (i=0; i<8; i++)
    lcd_write(LCD_DAT, 0xFF);
  for (i=0; i<8; i++)
    lcd_write(LCD_DAT, 0x00);
  wait100ms();
  for (i=0; i<8; i++)
    lcd_write(LCD_DAT, 0xFF);
  for (i=0; i<90; i++)
    lcd_write(LCD_DAT, 0x00);
  wait100ms();
  lcd_clear();
}
     
void lcd_full_bmp(unsigned char array[])
{
	int i;
	for (i = 0; i < LCD_WIDTH*LCD_HEIGHT/8; i++)
		lcd_write(LCD_DAT, array[i]);
}

void lcd_bmp(unsigned char array_b[], unsigned char array_w[], unsigned char array_f[])
{
	int i;
	for (i = 0; i < 14; i++)
		lcd_write(LCD_DAT, array_b[i]);
	for (i = 0; i < 70; i++)
		lcd_write(LCD_DAT, array_w[i]);
	for (i = 0; i < 420; i++)
		lcd_write(LCD_DAT, array_f[i]);
}

void lcd_display(unsigned char array_b[], char f)
{
  wait100ms();
  if(f==0)
      lcd_bmp(array_b, siren, fish0);
  if(f==1)
      lcd_bmp(array_b, siren, fish1);
  if(f==2)
      lcd_bmp(array_b, siren, fish2);
  if(f==3)
      lcd_bmp(array_b, siren, fish3);
  if(f==4)
      lcd_bmp(array_b, siren, fish4);
}

void lcd_backlight(char enabled)
{
	if (enabled)
		LCD_BACKLIGHT = 1;
	else
		LCD_BACKLIGHT = 0;
}

void lcd_init(void) 
{
	LCD_SCE = 1;
	LCD_BACKLIGHT = 1;
	LCD_RST = 0;
	wait100ms();
	LCD_RST = 1;

	lcd_write(LCD_CTR, 0x21); // extended instruction set
	lcd_write(LCD_CTR, 0xA9); // set Vop to 5V  	
	lcd_write(LCD_CTR, 0x04); // set the temperature coefficient  	
	lcd_write(LCD_CTR, 0x15); // set the bias system	  
	lcd_write(LCD_CTR, 0x20); // active mode, horizontal addressing, basic instruction set	  
	lcd_write(LCD_CTR, 0x0C); // normal mode	  
	lcd_clear(); // clear the LCD
	lcd_full_bmp(siem);  //show Siemen's logo
	wait500ms();
	lcd_clear;
}

void wait5ms(void) 
{ 
	int i; 
	for(i = 0; i<650; i++)   
	{ 
	;   // delay 5ms 
	}  
}    
    
void wait100ms(void) 
{ 
	unsigned char j; 
	for(j = 0; j<20; j++)  // delay 100ms = 20*5ms 
	{ 
		wait5ms(); 
	}  
}   

void wait500ms(void) 
{ 
	unsigned char j; 
	for(j = 0; j<5; j++)  // delay 500ms = 5*100ms 
	{ 
		wait100ms(); 
	}  
}

void system_init(void)
{ 
	//configure I/O pins
	DDRB = 0x3f;             // LCD pins (port B pins 0-5) as outputs
	DDRD = 0x5B;             // Set PTD bits 0-7 for XCVR in/out signals
	DDRA_DDRA0 = 1;          // Set PTA bit 0 for output (LED)
	PTAPUE_PTAPUE1 = 1;      // Enable pull-up for water switch on PTA1
	DDRA_DDRA2 = 1;          // Set PTA bit 2 for output (buzzer)
	PTAPUE_PTAPUE3 = 1;      // Enable pull-up for button on PTA3
	DDRA_DDRA4 = 1;          // Set PTA bit 4 for output (LED)

	//initialize interrupts
	EnableInterrupts;
	KBSCR_IMASKK = 1;	//mask keyboard interrupts
	KBIER_KBIE1 = 1;    //enable keyboard interrupt on bit 1 (water sensor)
	KBSCR_ACKK = 1;     //disable any false interrupts that may have occurred
	KBSCR_IMASKK = 0;   //clear mask bit for keyboard interrupts

	CONFIG1_COPD =1;   	//disable COP reset

	lcd_init();        	//initialize the LCD
	init_RFM22();      	//initialize all RFM22 registers
	LED_GREEN = 0;
	LED_RED = 0;
	BUZZER = 1;
	writeByte(0x1A, 0x1F);		//set LBD threshold to full battery > 3.2V (ADC=31)
	batt_level = batt_high;
	battery_level = BATTERY_HIGH;
	to_rx_mode();		//default in RX mode
}

void interrupt waterISR(void)  //interrupt service routine for if water is sensed
{
	to_tx_mode(water_buf, 17); //send packet alerting base station that child is drowning
	to_rx_mode();
	KBSCR_ACKK = 1;    //sends ACK to keyboard interrupt to clear the register
}

int main(void) 
{
	int timer = 0;
	uchar state = 1;
	uchar i;
	uchar frame = 0;
	BUZZER = 1;
	system_init();
	wait100ms();

	
	while(one)
	{         
		LED_GREEN = 0;
		LED_RED = 0;
		BUZZER = 1;
		
		if(XCVR_IRQ == 0)
		  locate_wristband();
		low_battery_detect();
				
		if(state == 0)  //idle state (LCD off)
		{
			if(BUTTON) 
			{
				state = 1;
				lcd_backlight(1); 
				frame = 0;
				timer = 0;
			}
		} 
		else if(state == 1)  //LCD on, fish swims 5x
		{
			if(BUTTON) 
			{
				wait100ms();
				if(BUTTON) //check to see that button has been held down
					state = 2;
		    }
			lcd_display(batt_level, frame);
			timer++;
			frame++;
			if(timer > 40) 
			{
				state = 0;
				lcd_clear();
				lcd_backlight(0); 
			}
			if(frame > 4) 
				frame = 0; 
		} 
		else if(state == 2) //if button held down when screen is on, go into sync mode
		{
		  wristband_sync();
		  state = 1;
		}
		wait5ms();
	}
}
